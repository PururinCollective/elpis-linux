## Config.in
```kconfig
source "$BR2_EXTERNAL_ELPIS_PATH/package/elpis-resolver/Config.in"
source "$BR2_EXTERNAL_ELPIS_PATH/package/elpis-config/Config.in"
```

## configs/elpis_x86_64_defconfig
```kconfig
BR2_x86_64=y
BR2_TOOLCHAIN_EXTERNAL=y
BR2_TOOLCHAIN_EXTERNAL_BOOTLIN=y
BR2_TOOLCHAIN_EXTERNAL_BOOTLIN_X86_64_MUSL_STABLE=y
BR2_TARGET_GENERIC_HOSTNAME="elpis"
BR2_TARGET_GENERIC_ISSUE="Elpis resolver appliance"
# BR2_TARGET_GENERIC_GETTY is not set
BR2_SYSTEM_DHCP="eth0"
BR2_ROOTFS_OVERLAY="$(BR2_EXTERNAL_ELPIS_PATH)/board/elpis/rootfs-overlay"
BR2_ROOTFS_POST_BUILD_SCRIPT="$(BR2_EXTERNAL_ELPIS_PATH)/board/elpis/post-build.sh"
BR2_ROOTFS_POST_IMAGE_SCRIPT="$(BR2_EXTERNAL_ELPIS_PATH)/board/elpis/post-image.sh"
BR2_LINUX_KERNEL=y
BR2_LINUX_KERNEL_CUSTOM_VERSION=y
BR2_LINUX_KERNEL_CUSTOM_VERSION_VALUE="6.18.33"
BR2_LINUX_KERNEL_DEFCONFIG="x86_64"
BR2_LINUX_KERNEL_CONFIG_FRAGMENT_FILES="$(BR2_EXTERNAL_ELPIS_PATH)/board/elpis/linux.fragment"
BR2_LINUX_KERNEL_NEEDS_HOST_LIBELF=y
BR2_LINUX_KERNEL_NEEDS_HOST_OPENSSL=y
BR2_PACKAGE_BUSYBOX_CONFIG_FRAGMENT_FILES="$(BR2_EXTERNAL_ELPIS_PATH)/board/elpis/busybox.fragment"
BR2_PACKAGE_DIFFUTILS=y
BR2_PACKAGE_E2FSPROGS=y
BR2_PACKAGE_UTIL_LINUX=y
BR2_PACKAGE_UTIL_LINUX_BINARIES=y
BR2_PACKAGE_UTIL_LINUX_PARTX=y
BR2_PACKAGE_MINISIGN=y
BR2_PACKAGE_DIALOG=y
BR2_PACKAGE_DROPBEAR=y
BR2_PACKAGE_ELPIS_RESOLVER=y
BR2_PACKAGE_ELPIS_CONFIG=y
BR2_TARGET_ROOTFS_CPIO=y
BR2_TARGET_ROOTFS_CPIO_XZ=y
# BR2_TARGET_ROOTFS_TAR is not set
BR2_TARGET_GRUB2=y
BR2_TARGET_GRUB2_I386_PC=y
BR2_TARGET_GRUB2_X86_64_EFI=y
BR2_PACKAGE_HOST_DOSFSTOOLS=y
BR2_PACKAGE_HOST_MINISIGN=y
BR2_PACKAGE_HOST_MTOOLS=y
BR2_PACKAGE_HOST_XORRISO=y
```

## package/elpis-config/Config.in
```kconfig
config BR2_PACKAGE_ELPIS_CONFIG
	bool "elpis-config"
	depends on BR2_PACKAGE_ELPIS_RESOLVER
	select BR2_PACKAGE_DIALOG
	help
	  Setup guide and menu for the Elpis appliance: network,
	  resolver settings, status page, time, SSH, updates and
	  storage, on the screen (tty1) or over SSH.  Every setting
	  also has a plain command (elpis-config --help).

comment "elpis-config needs elpis-resolver"
	depends on !BR2_PACKAGE_ELPIS_RESOLVER
```

## package/elpis-resolver/Config.in
```kconfig
config BR2_PACKAGE_ELPIS_RESOLVER
	bool "elpis-resolver"
	depends on BR2_TOOLCHAIN_HAS_THREADS
	help
	  Elpis: a private, validating, recursive DNS resolver in C99.

	  https://github.com/PururinCollective/elpis-resolver

if BR2_PACKAGE_ELPIS_RESOLVER

config BR2_PACKAGE_ELPIS_RESOLVER_LICENCE_ISSUER
	string "licence issuer key"
	help
	  Ed25519 public key, in hex, that deployment licences are
	  checked against: the resolver's LICENCE_ISSUER build
	  variable. Leave empty to build exactly as the published tree
	  does, without an issuer key.

endif

comment "elpis-resolver needs a toolchain w/ threads"
	depends on !BR2_TOOLCHAIN_HAS_THREADS
```
